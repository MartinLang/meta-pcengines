## conf/distro/include/pce-distro.inc
```bitbake
require conf/distro/poky.conf

DISTRO_NAME = "Reference Yocto distro for PC Engines hardware"
DISTRO_VERSION = "0.1"
SDK_VENDOR = "-pcesdk"
TARGET_VENDOR = "-pce"

MAINTAINER = "maciej.pijanowski@3mdeb.com"

DISTRO_FEATURES = " \
    ext2 \
    keyboard \
    largefile \
    ldconfig \
    nfs \
    pci \
    systemd \
    usbgadget \
    usbhost \
    virtualization \
"

# disable sysvinit
VIRTUAL-RUNTIME_init_manager = "systemd"
VIRTUAL-RUNTIME_initscripts = ""
VIRTUAL-RUNTIME_syslog = ""
DISTRO_FEATURES_BACKFILL_CONSIDERED += "sysvinit"

PREFERRED_VERSION_linux-yocto ?= "4.19%"

# persistent data directory to use in recipes
PERSISTENT_DATA_DIR = "/data"

IMAGE_FSTYPES = "wic.gz wic.bmap"
WKS_FILE = "grub-legacy-dual-image.wks"

# pass extra args to wic to allow splitting out data directory from rootfs
WIC_CREATE_EXTRA_ARGS = "\
    --rootfs-dir rootfs-main=${IMAGE_ROOTFS} \
    --rootfs-dir rootfs-data=${IMAGE_ROOTFS}${PERSISTENT_DATA_DIR} \
    "
```

## conf/machine/include/tune-dbft1.inc
```bitbake
DEFAULTTUNE ?= "dbft1"

require conf/machine/include/x86/arch-x86.inc
require conf/machine/include/x86/x86-base.inc

# AMD DB-FT1 64bit (Brazos)
TUNEVALID[dbft1] = "Enable AMD DB-FT1 (64 bit) specific processor optimizations"
TUNECONFLICTS[dbft1] = "m32 mx32"
TUNE_CCARGS .= "${@bb.utils.contains("TUNE_FEATURES", "dbft1", " -march=btver1", "", d)}"

# Extra tune selections
AVAILTUNES += "dbft1"
TUNE_FEATURES:tune-dbft1 = "m64 dbft1"
BASE_LIB:tune-dbft1 = "lib64"
TUNE_PKGARCH:tune-dbft1 = "dbft1"
PACKAGE_EXTRA_ARCHS:tune-dbft1 = "${TUNE_PKGARCH:tune-dbft1}"
```

## conf/machine/pcengines-apu.conf
```bitbake
#@TYPE: Machine
#@NAME: pcengines-apu1

#@DESCRIPTION: Machine configuration for pcengines-apu systems
 
#provides gcc tune for Family 14h
require conf/machine/include/tune-dbft1.inc

# Metadata used by CodeBench for the ADE
ADE_CB_CPU = "general.cpu.bobcat"
APU_VERSION = "1"

require conf/machine/include/pcengines-apux.inc


QB_DEFAULT_FSTYPE = "${IMAGE_FSTYPES}"

do_image_wic[depends] += "grub-native:do_populate_sysroot"
```

## conf/machine/pcengines-apu2.conf
```bitbake
#@TYPE: Machine
#@NAME: pcengines-apu2

#@DESCRIPTION: Machine configuration for pcengines-apu2 systems

# provides gcc tune for Family 16h
require conf/machine/include/tune-dbft3b.inc

# Metadata used by CodeBench for the ADE
ADE_CB_CPU = "general.cpu.jaguar"
APU_VERSION = "2"

require conf/machine/include/pcengines-apux.inc


QB_DEFAULT_FSTYPE = "${IMAGE_FSTYPES}"

do_image_wic[depends] += "grub-native:do_populate_sysroot"
```

## wic/grub-legacy-dual-image.wks
```
part /boot  --source bootimg-grub-legacy  --ondisk sda --label msdos --active --align 1024
part /      --source rootfs --rootfs-dir=rootfs-main  --ondisk sda --fstype=ext4 --label rootfsA --align 1024 --fixed-size 2048 --exclude-path data/
part        --source rootfs --rootfs-dir=rootfs-main  --ondisk sda --fstype=ext4 --label rootfsB --align 1024 --fixed-size 2048 --exclude-path data/
part /data  --source rootfs --rootfs-dir=rootfs-data  --ondisk sda --fstype=ext4 --label data    --align 1024 --fixed-size 10240
bootloader  --ptable msdos --timeout=5 --append="rootfstype=ext4 console=ttyS0,115200 earlyprintk=serial,ttyS0,115200"
```

## wic/xen-server-app.wks
```
# short-description: Create a 'pcbios' direct disk image with Xen hypervisor and bootloader config + additional LVM volume for VMs
# long-description: Creates a partitioned legacy BIOS disk image to boot Xen
# with a bootloader config that the user can directly dd to boot media.
# Boot files are located on the first vfat partition.
# Additional LVM PV is used for VMs

part /boot --source bootimg-biosxen --ondisk sda --label boot --active --align 1024

# For the main partition, it can be useful to add additional space for VMs;
# eg. increase partition size by appending: --size 10G
part / --source rootfs --ondisk sda --use-uuid --fstype=ext4 --label root --align 1024
# LVM Partition (type= E6D6D379-F507-44C2-A23C-238F2A3DF928)
part --size 4G --part-type=E6D6D379-F507-44C2-A23C-238F2A3DF928

bootloader --configfile="directdisk-bootloader-xen.cfg"
```
